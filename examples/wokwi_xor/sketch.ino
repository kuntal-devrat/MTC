/* Generated by MTC 0.1.0. Upload with mtc_model.c and mtc_model.h. */
#include <Arduino.h>
#include <stdint.h>
#include "mtc_model.h"

static const int16_t training_inputs[MTC_TRAIN_SAMPLES][MTC_INPUT_SIZE] = {
    {0, 0},
    {0, 32767},
    {32767, 0},
    {32767, 32767}
};
static const int16_t training_targets[MTC_TRAIN_SAMPLES][MTC_OUTPUT_SIZE] = {
    {0},
    {32767},
    {32767},
    {0}
};

static uint32_t epoch = 0;
static bool training_complete = false;

void setup() {
    Serial.begin(115200);
    delay(250);
    mtc_reset();
    Serial.printf("MTC ESP32 trainer: xor_net\n");
    Serial.printf("Q15 | samples=%u | epochs=%u | static_ram=%u bytes\n",
                  (unsigned)MTC_TRAIN_SAMPLES, (unsigned)MTC_EPOCHS,
                  (unsigned)MTC_STATIC_RAM_BYTES);
}

void loop() {
    if (training_complete) {
        delay(1000);
        return;
    }
    if (epoch >= MTC_EPOCHS) {
        training_complete = true;
        int16_t prediction[MTC_OUTPUT_SIZE];
        for (uint32_t sample = 0; sample < MTC_TRAIN_SAMPLES; ++sample) {
            mtc_forward(training_inputs[sample], prediction);
            Serial.printf("sample=%u target=%.4f output=%.4f\n", (unsigned)sample,
                          (double)training_targets[sample][0] / 32768.0,
                          (double)prediction[0] / 32768.0);
        }
        Serial.println("training complete");
        return;
    }

    int64_t total_loss = 0;
    for (uint32_t sample = 0; sample < MTC_TRAIN_SAMPLES; ++sample) {
        total_loss += mtc_train_sample(training_inputs[sample], training_targets[sample]);
    }
    ++epoch;
    const float mean_loss = (float)total_loss / (float)MTC_TRAIN_SAMPLES / 32768.0f;
    Serial.printf("epoch=%lu loss=%.6f\n", (unsigned long)epoch, mean_loss);
}
